## conf/distro/opal6-framebuffer.conf
```bitbake
# Opal6 Distro for FrameBuffer graphical backend.

require conf/distro/include/fslc-base.inc

DISTRO = "opal6-framebuffer"
DISTRO_NAME = "Opal6 FrameBuffer"

# Remove conflicting backends.
DISTRO_FEATURES_remove = "x11 wayland directfb vulkan"
DISTRO_FEATURES_append = " pam systemd"
VIRTUAL-RUNTIME_init_manager = "systemd"

IMAGE_FSTYPES = "tar.bz2"
```

## conf/distro/opal6-wayland.conf
```bitbake
# FSLC Distro for Wayland.

require conf/distro/include/fslc-base.inc

DISTRO = "opal6-wayland"
DISTRO_NAME = "Opal6 Wayland"

DISTRO_FEATURES_remove = "directfb x11 ofono sysvinit 3g "
DISTRO_FEATURES_append = " wayland pam systemd"
VIRTUAL-RUNTIME_init_manager = "systemd"

IMAGE_FSTYPES = "tar.bz2"
```

## conf/distro/opal6-x11.conf
```bitbake
# FSLC Distro for X11 without wayland.

require conf/distro/include/fslc-base.inc

DISTRO = "opal6-x11"
DISTRO_NAME = "Opal6 X11"

DISTRO_FEATURES_remove = "wayland ofono sysvinit 3g"
DISTRO_FEATURES_append = " x11 polkit pam systemd"
VIRTUAL-RUNTIME_init_manager = "systemd"

IMAGE_FSTYPES = "tar.bz2"
```

## conf/layer.conf
```bitbake
# We have a conf and classes directory, add to BBPATH
BBPATH .= ":${LAYERDIR}"

# We have recipes-* directories, add to BBFILES
BBFILES += "${LAYERDIR}/recipes-*/*/*.bb \
	${LAYERDIR}/recipes-*/*/*.bbappend"

BBFILE_COLLECTIONS += "opal6-demos"
BBFILE_PATTERN_opal6-demos = "^${LAYERDIR}/"
BBFILE_PRIORITY_opal6-demos = "4"
LAYERSERIES_COMPAT_opal6-demos = "sumo thud warrior"
```

## conf/machine/opal6dl.conf
```bitbake
#@TYPE: Machine
#@NAME: Device Solutions Opal6DL
#@SOC: i.MX6DL
#@DESCRIPTION: Machine configuration for Device Solutions Opal IMX.6DL Board
#@MAINTAINER: John Inglis <john@clanbyte.com>

include conf/machine/include/imx-base.inc
include conf/machine/include/tune-cortexa9.inc

SOC_FAMILY = "mx6:mx6dl:mx6q"

KERNEL_DEVICETREE = "imx6dl-opaldk.dtb"

KERNEL_IMAGETYPE = "uImage"

PREFERRED_PROVIDER_u-boot = "u-boot-opal6"
PREFERRED_PROVIDER_virtual/kernel ?= "linux-opal6"
#PREFERRED_VERSION_linux-opal6 ?= "3.10.17"
PREFERRED_VERSION_linux-opal6 ?= "3.14.28"

# Ensure boot scripts will be available at rootfs time
do_rootfs[depends] += "u-boot-script-opal6:do_deploy"

# Boot scripts to install
BOOT_SCRIPTS = "6x_bootscript-${MACHINE}:6x_bootscript"

UBOOT_MACHINE ?= "dsopal6_config"

SERIAL_CONSOLE = "115200 ttymxc3"

MACHINE_FEATURES += " pci wifi"
```

## conf/machine/opal6q.conf
```bitbake
#@TYPE: Machine
#@NAME: Device Solutions Opal6Q 2GB RAM
#@SOC: i.MX6Q
#@DESCRIPTION: Machine configuration for Device Solutions Opal IMX.6Q Board
#@MAINTAINER: John Inglis <john@devicesolutions.net>

include conf/machine/include/imx-base.inc
include conf/machine/include/tune-cortexa9.inc

MACHINEOVERRIDES =. "mx6:mx6q:"

KERNEL_DEVICETREE = "imx6q-opaldk.dtb"

KERNEL_IMAGETYPE = "uImage"

PREFERRED_PROVIDER_u-boot = "u-boot-opal6"
PREFERRED_PROVIDER_virtual/kernel ?= "linux-opal6"
PREFERRED_VERSION_linux-opal6 ?= "4.1.15"

# Ensure boot scripts will be available at rootfs time
do_rootfs[depends] += "u-boot-script-opal6:do_deploy"

# Boot scripts to install
BOOT_SCRIPTS = "6x_bootscript-${MACHINE}:6x_bootscript"

UBOOT_MACHINE ?= "opal6q2g_config"

SERIAL_CONSOLE = "115200 ttymxc3"

MACHINE_FEATURES += " pci wifi"
```

## conf/machine/opal6s.conf
```bitbake
#@TYPE: Machine
#@NAME: Device Solutions Opal6S
#@SOC: i.MX6DL
#@DESCRIPTION: Machine configuration for Device Solutions Opal IMX.6S Board
#@MAINTAINER: John Inglis

include conf/machine/include/imx-base.inc
include conf/machine/include/tune-cortexa9.inc

SOC_FAMILY = "mx6:mx6dl:mx6q"

KERNEL_DEVICETREE = "imx6dl-opaldk.dtb"

KERNEL_IMAGETYPE = "uImage"

PREFERRED_PROVIDER_u-boot = "u-boot-opal6"
PREFERRED_PROVIDER_virtual/kernel ?= "linux-opal6"
PREFERRED_VERSION_linux-opal6 ?= "4.1.15"

# Ensure boot scripts will be available at rootfs time
do_rootfs[depends] += "u-boot-script-opal6:do_deploy"

# Boot scripts to install
BOOT_SCRIPTS = "6x_bootscript-${MACHINE}:6x_bootscript"

UBOOT_MACHINE ?= "opal6s_config"

SERIAL_CONSOLE = "115200 ttymxc3"

MACHINE_FEATURES += " pci wifi"
```
